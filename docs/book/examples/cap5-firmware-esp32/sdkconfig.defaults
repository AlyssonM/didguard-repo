## docs/book/examples/cap5-firmware-esp32/sdkconfig.defaults
```kconfig
CONFIG_ESPTOOLPY_FLASHSIZE_4MB=y
CONFIG_ESP_MAIN_TASK_STACK_SIZE=8192
CONFIG_ESP_WIFI_ENABLED=y
CONFIG_MBEDTLS_PSA_CRYPTO_CLIENT=y
CONFIG_FREERTOS_UNICORE=n
```
